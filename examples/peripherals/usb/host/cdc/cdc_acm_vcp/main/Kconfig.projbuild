## examples/peripherals/usb/host/cdc/cdc_acm_vcp/main/Kconfig.projbuild
```kconfig
menu "Example Configuration"

    choice
        prompt "USB-to-UART device type"
        default EXAMPLE_USE_CP210X
        help
            Type of UART converter to use in this example.

        config EXAMPLE_USE_FTDI
            bool "FT232"
        config EXAMPLE_USE_CP210X
            bool "CP2012"
        config EXAMPLE_USE_CH340
            bool "CH340"
    endchoice

endmenu
```
